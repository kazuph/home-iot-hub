## main/Kconfig.projbuild
```kconfig
menu "Home IoT Hub config"

    config WIFI_RETRY_INFINITE
        bool "WiFi infinite retries"
        default y
        help
            Set if WiFi should retry connection infinite times.

    config WIFI_MAXIMUM_RETRY
        int "WiFi Connection Retries"
        depends on !WIFI_RETRY_INFINITE
        default 5
        help
            Maximum WiFi connection retries.
endmenu

menu "BLE supported devices"

    config SUPPORT_XIAOMI_MI_KETTLE
        bool "Xiaomi Mi Kettle"
        default n
        help
            Enable suport for Xiaomi Mi Kettle.
            
    config SUPPORT_XIAOMI_MI_COMPOSITION_SCALE_2
        bool "Xiaomi Mi Composition Scale 2"
        default n
        help
            Enable suport for Xiaomi Mi Composition Scale 2.

endmenu
```
